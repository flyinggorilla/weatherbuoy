## components/cellular/Kconfig.projbuild
```kconfig
menu "Cellular"
    choice CELLULAR_DEVICE
        prompt "Choose supported modem"
        default LILYGO_TTGO_TCALL14_SIM800
        help
            Select modem device connected..
        config LILYGO_TTGO_TCALL14_SIM800
            bool "LILYGO_TTGO_TCALL14_SIM800"
            help
                Lilygo TTGP T-Call 1.4 ESP32 module with 
                SIMCom SIM800L, a GSM/GPRS module.
                It supports Quad-band 850/900/1800/1900MHz.
        config LILYGO_TTGO_TPCIE_SIM7600
            bool "LILYGO_TTGO_TPCIE_SIM7600"
            help
                Lilygo TTGP T-PCIE ESP32 module with SIM7600E modem
                SIM7600 is Multi-Band LTE-TDD/LTE-FDD/HSPA+ and GSM/GPRS/EDGE module
    endchoice

    # menu "UART Configuration"
    #     config CELLULAR_MODEM_UART_EVENT_TASK_PRIORITY
    #         int "UART Event Task Priority"
    #         range 3 22
    #         default 5
    #         help
    #             Priority of UART event task.

    #     config CELLULAR_MODEM_UART_EVENT_QUEUE_SIZE
    #         int "UART Event Queue Size"
    #         range 5 40
    #         default 10
    #         help
    #             Length of UART event queue.

    #     config CELLULAR_MODEM_UART_RX_BUFFER_SIZE
    #         int "UART RX Buffer Size"
    #         range 256 2048
    #         default 2048
    #         help
    #             Buffer size of UART RX buffer.
    # endmenu

endmenu
```

## main/Kconfig.projbuild
```kconfig
menu "Weatherbuoy"

    config WEATHERBUOY_WIFI_STA_SSID
        string "Default WiFi Station SSID"

    config WEATHERBUOY_WIFI_STA_PASS
        string "Default WiFi Station Password"

    config WEATHERBUOY_HOSTNAME
        string "Default Hostname and AP SSID. Max 32 char."
        default "buoytest"
        help
            Default Hostname. Will be also used for Wifi AP SSID. Max 32 char.

    config WEATHERBUOY_WIFI_AP_PASS
        string "Default WiFi AP Password."
        default ""

    config WEATHERBUOY_NTPSERVER
        string "Default NTP Server."
        default "pool.ntp.org"
        help
            NTP server hostname. e.g. at.pool.ntp.org.
    
    config WEATHERBUOY_TARGET_URL
        string "Default target URL to send data and retrieve configuration."

    config WEATHERBUOY_CELLULAR_APN
        string "Network provider APN"
            
    config WEATHERBUOY_CELLULAR_USER
        string "Network provider USER (Leave blank for Yesss network)."
        default ""
    
    config WEATHERBUOY_CELLULAR_PASS
        string "Network provider PASS (Leave blank for Yesss network)."
        default ""

    config WEATHERBUOY_CELLULAR_OPERATOR
        string "Preferred network operator. Default = A1"
        default "A1"

    config WEATHERBUOY_CELLULAR_NETWORK
        int "Preferred network mode. Default = 2 (automatic)"
        help  
              2 - Automatic
              9 - CDMA Only
              13 - GSM Only
              14 - WCDMA Only
              38 – LTE Only
              59 – TDS-CDMA Only
              10 – EVDO Only
              19 – GSM+WCDMA Only
              22 – CDMA+EVDO Only
              48 – Any but LTE
              60 – GSM+TDSCDMA Only
              63 – GSM+WCDMA+TDSCDMA Only
              67 – CDMA+EVDO+GSM+WCDMA+TDSCDMA Only
              39 – GSM+WCDMA+LTE Only
              51 – GSM+LTE Only
              54 – WCDMA+LTE Only
        default 2

    config WEATHERBUOY_MAXIMET_SIMULATOR
        int "Simulate Maximet via Serial. Default = 0 (off)"
        help  
                0 - Off
                2001 - Maximet GMX200 with GPS
                5010 - Maximet GMX501
                5011 - Maximet GMX501 with GPS
        default 0

    config WEATHERBUOY_SENDDATA_INTERVAL_DAY
        int "Interval in seconds to send data at daytime. default = 60 seconds."
        default 60   

    config WEATHERBUOY_SENDDATA_INTERVAL_NIGHT
        int "Interval in seconds to send data at daytime. default = 300 seconds."
        default 300   

    config WEATHERBUOY_SENDDATA_INTERVAL_DIAGNOSTICS
        int "Interval in seconds to send data at daytime. default = 900 seconds."
        default 900   

    config WEATHERBUOY_SENDDATA_INTERVAL_LOWBATTERY
        int "Interval in seconds to send data at daytime. default = 3600 seconds."
        default 3600   
            
       

endmenu
```

## sdkconfig.defaults
```kconfig
###################
# Mandatory overrides for default sdkconfig (idf.py menuconfig)
# This list will be used when creating a new sdkconfig from scratch
#

#
# Flash
#
CONFIG_ESPTOOLPY_FLASHSIZE_4MB=y
CONFIG_ESPTOOLPY_FLASHSIZE="4MB"
CONFIG_ESPTOOLPY_FLASHMODE_QIO=y
CONFIG_ESPTOOLPY_FLASHMODE="dio"


#
# Partition Table
#
CONFIG_PARTITION_TABLE_CUSTOM=y
CONFIG_PARTITION_TABLE_CUSTOM_FILENAME="partitions.csv"
CONFIG_PARTITION_TABLE_FILENAME="partitions.csv"
CONFIG_PARTITION_TABLE_OFFSET=0x8000



# ESP HTTP client
#
CONFIG_ESP_HTTP_CLIENT_ENABLE_HTTPS=y


#
# Bootloader config
#
CONFIG_BOOTLOADER_APP_ROLLBACK_ENABLE=y


#
# ESP-TLS
#
CONFIG_ESP_TLS_INSECURE=y
CONFIG_ESP_TLS_SKIP_SERVER_CERT_VERIFY=y  

#
# PPP
#
CONFIG_PPP_SUPPORT=y
CONFIG_PPP_NOTIFY_PHASE_SUPPORT=y
CONFIG_LWIP_PPP_SUPPORT=y
CONFIG_LWIP_PPP_NOTIFY_PHASE_SUPPORT=y
# CONFIG_LWIP_PPP_ENABLE_IPV6 is not set
# CONFIG_LWIP_PPP_PAP_SUPPORT is not set
# CONFIG_LWIP_PPP_DEBUG_ON=y
# CONFIG_LWIP_PPP_PAP_SUPPORT=y



#
# LWIP
#
CONFIG_LWIP_IP4_REASSEMBLY=y
CONFIG_LWIP_IP6_REASSEMBLY=y
# CONFIG_LWIP_DHCP_DOES_ARP_CHECK not set
# CONFIG_LWIP_ESP_GRATUITOUS_ARP is not set



#
# CPU
#
CONFIG_ESP32_DEFAULT_CPU_FREQ_160=y
CONFIG_ESP32_DEFAULT_CPU_FREQ_MHZ=160


#
# Weatherbuoy
#
CONFIG_WEATHERBUOY_WIFI_STA_SSID=""
CONFIG_WEATHERBUOY_WIFI_STA_PASS=""
CONFIG_WEATHERBUOY_HOSTNAME="buoyinit"
CONFIG_WEATHERBUOY_WIFI_AP_PASS=""
CONFIG_WEATHERBUOY_SENDDATA_INTERVAL_DAYTIME=10
CONFIG_WEATHERBUOY_SENDDATA_INTERVAL_NIGHTTIME=60
CONFIG_WEATHERBUOY_SENDDATA_INTERVAL_HEALTH=300
CONFIG_WEATHERBUOY_CELLULAR_APN="webapn.at"
CONFIG_WEATHERBUOY_CELLULAR_USER=""
CONFIG_WEATHERBUOY_CELLULAR_PASS=""
CONFIG_WEATHERBUOY_CELLULAR_OPERATOR="A1"
CONFIG_WEATHERBUOY_CELLULAR_NETWORK=51
CONFIG_WEATHERBUOY_SENDDATA_INTERVAL_DAY=60   
CONFIG_WEATHERBUOY_SENDDATA_INTERVAL_NIGHT=300 
CONFIG_WEATHERBUOY_SENDDATA_INTERVAL_DIAGNOSTICS=900
CONFIG_WEATHERBUOY_SENDDATA_INTERVAL_LOWBATTERY=3600 

#
# Cellular
#
# CONFIG_LILYGO_TTGO_TCALL14_SIM800 is not set
CONFIG_LILYGO_TTGO_TPCIE_SIM7600=y
# end of Cellular


#
# ESP32-specific
#
CONFIG_ESP32_REV_MIN_1=y
CONFIG_ESP32_REV_MIN=1


#
# UART configuration
#
CONFIG_UART_ISR_IN_IRAM=y
# end of UART configuration


#
# Common ESP-related
# Main stack size: default is 3584, Configure the "main task" stack size. This is the stack of the task which calls app_main(). If app_main() returns then this task is deleted and its stack memory is freed.
CONFIG_ESP_MAIN_TASK_STACK_SIZE=8192   

#
# TWAI configuration
#
CONFIG_TWAI_ISR_IN_IRAM=y

#
# Compiler options
#
CONFIG_COMPILER_OPTIMIZATION_SIZE=y


#
# Log output
#
# use system time instead of millisecs since start.
CONFIG_LOG_TIMESTAMP_SOURCE_SYSTEM=y


#
# Certificate Bundle
#
# save a bit code size by setting TLS client only mode
CONFIG_MBEDTLS_TLS_CLIENT_ONLY=y
CONFIG_MBEDTLS_TLS_CLIENT=y

#
# ADC and ADC Calibration
#
CONFIG_ADC_ONESHOT_CTRL_FUNC_IN_IRAM=y
# CONFIG_ADC_CONTINUOUS_ISR_IRAM_SAFE is not set
```
